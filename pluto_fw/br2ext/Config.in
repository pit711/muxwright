## pluto_fw/br2ext/Config.in
```kconfig
source "$BR2_EXTERNAL_DABLAB_PATH/package/dablab-agent/Config.in"
source "$BR2_EXTERNAL_DABLAB_PATH/package/iqplay/Config.in"
source "$BR2_EXTERNAL_DABLAB_PATH/package/dablab-mod/Config.in"
```

## pluto_fw/br2ext/package/dablab-agent/Config.in
```kconfig
config BR2_PACKAGE_DABLAB_AGENT
	bool "dablab-agent (HTTP/JSON-Steuerdienst, Port 8080)"
	select BR2_PACKAGE_LIBIIO
	select BR2_PACKAGE_LIBAD9361_IIO
	help
	  Steuerdienst des DAB-Lab auf dem Pluto: Modulator starten/stoppen,
	  Status, DAC-Rate/FIR, RF. Quelle: pluto_fw/agent.
```

## pluto_fw/br2ext/package/dablab-mod/Config.in
```kconfig
config BR2_PACKAGE_DABLAB_MOD
	bool "dablab-mod (Modulatoren aus pluto_fw/mod: dvbc_mod, dvbt_mod, fm_mod ...)"
	select BR2_PACKAGE_LIBIIO
	select BR2_PACKAGE_LIBAD9361_IIO
	help
	  Baut jedes Unterverzeichnis von pluto_fw/mod, das ein Makefile oder
	  eine CMakeLists.txt enthält, mit dem Cross-Compiler (NEON, hard-float, -O3)
	  und installiert die erzeugten Programme nach /usr/bin.
```

## pluto_fw/br2ext/package/iqplay/Config.in
```kconfig
config BR2_PACKAGE_IQPLAY
	bool "iqplay (IQ-Datei/UDP/Nullen lokal in den DAC spielen)"
	select BR2_PACKAGE_LIBIIO
	select BR2_PACKAGE_LIBAD9361_IIO
	help
	  Testwerkzeug: spielt IQ-Daten über den lokalen IIO-Kontext in den DAC,
	  zyklisch oder fortlaufend, und zählt DAC-Underflows. Quelle: pluto_fw/iqplay.
```
